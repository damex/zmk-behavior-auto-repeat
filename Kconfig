## Kconfig
```kconfig
# Copyright 2026 Roman Kuzmitskii (@damex)
# SPDX-License-Identifier: MIT

config ZMK_BEHAVIOR_AUTO_REPEAT
    bool
    default y
    depends on DT_HAS_ZMK_BEHAVIOR_AUTO_REPEAT_ENABLED || \
               DT_HAS_ZMK_BEHAVIOR_AUTO_REPEAT_SPEED_ENABLED
    depends on !ZMK_SPLIT || ZMK_SPLIT_ROLE_CENTRAL
    help
      Auto-repeat behaviors, built on central or non-split keyboards only.

if ZMK_BEHAVIOR_AUTO_REPEAT

module = ZMK_BEHAVIOR_AUTO_REPEAT
module-str = zmk_behavior_auto_repeat
source "subsys/logging/Kconfig.template.log_config"

endif
```

## dts/bindings/behaviors/zmk,behavior-auto-repeat-speed.yaml
```yaml
# Copyright 2026 Roman Kuzmitskii (@damex)
# SPDX-License-Identifier: MIT
---
description: Speed every auto-repeat up or down by one step.

compatible: zmk,behavior-auto-repeat-speed

include: one_param.yaml
```

## dts/bindings/behaviors/zmk,behavior-auto-repeat.yaml
```yaml
# Copyright 2026 Roman Kuzmitskii (@damex)
# SPDX-License-Identifier: MIT
---
description: Hold and press keys to toggle their timed repeat.

compatible: zmk,behavior-auto-repeat

include: zero_param.yaml

properties:
  interval-ms:
    type: int
    default: 50
    description: Press to press time at boot.
  tap-ms:
    type: int
    default: 10
    description: Hold time per tap.
  interval-step-ms:
    type: int
    default: 10
    description: Interval change per faster or slower command.
  interval-min-ms:
    type: int
    default: 20
    description: Shortest interval, above tap-ms.
  interval-max-ms:
    type: int
    default: 500
    description: Longest interval.
  max-active:
    type: int
    default: 4
    description: Keys repeating at once.
  tapping-term-ms:
    type: int
    default: 200
    description: Longest lone modifier press that still picks it.
  layers:
    type: array
    description: Layers on which every key press starts or stops repeat.
```

## tests/unit/testcase.yaml
```yaml
# Copyright 2026 Roman Kuzmitskii (@damex)
# SPDX-License-Identifier: MIT
---
common:
  tags:
    - auto_repeat

tests:
  auto_repeat.unit:
    type: unit
```
