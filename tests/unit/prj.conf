## CMakeLists.txt
```
# Copyright 2026 Roman Kuzmitskii (@damex)
# SPDX-License-Identifier: MIT

cmake_minimum_required(VERSION 3.20.0)

project(auto_repeat_unit_test)
find_package(Zephyr COMPONENTS unittest HINTS $ENV{ZEPHYR_BASE})

# Zephyr unittest forces -m32, which needs 32-bit glibc on host.
string(REPLACE "-m32" "-m64" CMAKE_C_FLAGS "${CMAKE_C_FLAGS}")
string(REPLACE "-m32" "-m64" CMAKE_CXX_FLAGS "${CMAKE_CXX_FLAGS}")

set(auto_repeat_root ${CMAKE_CURRENT_SOURCE_DIR}/../..)

target_include_directories(testbinary PRIVATE
  ${auto_repeat_root}/src
)

target_sources(testbinary PRIVATE
  src/test_auto_repeat_interval.c
  ${auto_repeat_root}/src/auto_repeat_interval.c
)

set(auto_repeat_strict_flags
  -Wall
  -Werror
  -Wextra
  -Wshadow
  -Wformat=2
  -Wformat-truncation=2
  -Wformat-overflow=2
  -Wformat-signedness
  -Wlogical-op
  -Wduplicated-cond
  -Wduplicated-branches
  -Wmissing-prototypes
  -Wmissing-declarations
  -Wjump-misses-init
  -Wwrite-strings
  -Winit-self
  -Wold-style-definition
  -Wswitch-enum
  -Wswitch-default
  -Wimplicit-fallthrough=5
  -Wnull-dereference
  -Wvla
  -Walloca
  -Wfloat-equal
  -Wshift-overflow=2
  -Wstringop-overflow=4
  -Warray-bounds=2
  -Wstrict-overflow=2
  -Wtrampolines
  -Wstack-usage=256
  -fanalyzer
)

set_source_files_properties(${auto_repeat_root}/src/auto_repeat_interval.c
  PROPERTIES COMPILE_OPTIONS "${auto_repeat_strict_flags}"
)

target_compile_options(testbinary PRIVATE
  -fsanitize=address,undefined
  -fno-sanitize-recover=all
)

target_link_options(testbinary PRIVATE
  -fsanitize=address,undefined
)
```

## prj.conf
```kconfig
# Copyright 2026 Roman Kuzmitskii (@damex)
# SPDX-License-Identifier: MIT

CONFIG_ZTEST=y
```

## src/test_auto_repeat_interval.c
```c
// Copyright 2026 Roman Kuzmitskii (@damex)
// SPDX-License-Identifier: MIT

/* Interval step and clamp tests, real auto_repeat_interval.c. */

#include <stdint.h>

#include <zephyr/ztest.h>

#include "auto_repeat_interval.h"

#define INTERVAL_MS 50
#define STEP_MS 10
#define PARTIAL_STEP_MS 5
#define MINIMUM_MS 20
#define MAXIMUM_MS 500
#define WIDE_STEP_MS 30
#define BELOW_WIDE_STEP_MS 10

static const struct auto_repeat_interval_limits limits = {
    .step_ms = STEP_MS,
    .minimum_ms = MINIMUM_MS,
    .maximum_ms = MAXIMUM_MS,
};

ZTEST_SUITE(auto_repeat_interval, NULL, NULL, NULL, NULL, NULL);

ZTEST(auto_repeat_interval, test_faster_takes_one_step) {
    zassert_equal(auto_repeat_interval_faster(INTERVAL_MS, &limits), INTERVAL_MS - STEP_MS);
}

ZTEST(auto_repeat_interval, test_faster_stops_at_minimum) {
    zassert_equal(auto_repeat_interval_faster(MINIMUM_MS + PARTIAL_STEP_MS, &limits), MINIMUM_MS);
    zassert_equal(auto_repeat_interval_faster(MINIMUM_MS, &limits), MINIMUM_MS);
}

ZTEST(auto_repeat_interval, test_faster_below_one_step_lands_on_minimum) {
    const struct auto_repeat_interval_limits wide_step = {
        .step_ms = WIDE_STEP_MS,
        .minimum_ms = 1,
        .maximum_ms = MAXIMUM_MS,
    };
    uint32_t interval_ms = auto_repeat_interval_faster(BELOW_WIDE_STEP_MS, &wide_step);
    zassert_equal(interval_ms, wide_step.minimum_ms);
}

ZTEST(auto_repeat_interval, test_slower_takes_one_step) {
    zassert_equal(auto_repeat_interval_slower(INTERVAL_MS, &limits), INTERVAL_MS + STEP_MS);
}

ZTEST(auto_repeat_interval, test_slower_stops_at_maximum) {
    zassert_equal(auto_repeat_interval_slower(MAXIMUM_MS - PARTIAL_STEP_MS, &limits), MAXIMUM_MS);
    zassert_equal(auto_repeat_interval_slower(MAXIMUM_MS, &limits), MAXIMUM_MS);
}

ZTEST(auto_repeat_interval, test_slower_near_type_maximum_stays_at_maximum) {
    const struct auto_repeat_interval_limits unbounded = {
        .step_ms = STEP_MS,
        .minimum_ms = MINIMUM_MS,
        .maximum_ms = UINT32_MAX,
    };
    uint32_t interval_ms = auto_repeat_interval_slower(UINT32_MAX - PARTIAL_STEP_MS, &unbounded);
    zassert_equal(interval_ms, UINT32_MAX);
}
```
