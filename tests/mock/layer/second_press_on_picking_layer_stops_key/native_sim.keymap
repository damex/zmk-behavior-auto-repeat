// Copyright 2026 Roman Kuzmitskii (@damex)
// SPDX-License-Identifier: MIT

#include "../../keymap.dtsi"

&kscan {
    /delete-property/ exit-after;
    events = <
        ZMK_MOCK_PRESS(2,1,5)
        ZMK_MOCK_RELEASE(2,1,5)
        ZMK_MOCK_PRESS(0,2,5)
        ZMK_MOCK_RELEASE(0,2,75)
        ZMK_MOCK_PRESS(0,2,5)
        ZMK_MOCK_RELEASE(0,2,5)
        ZMK_MOCK_PRESS(2,1,5)
        ZMK_MOCK_RELEASE(2,1,10)
    >;
};
