// Copyright 2026 Roman Kuzmitskii (@damex)
// SPDX-License-Identifier: MIT

#include "../../keymap.dtsi"

&kscan {
    /delete-property/ exit-after;
    events = <
        ZMK_MOCK_PRESS(0,0,5)
        ZMK_MOCK_PRESS(1,0,5)
        ZMK_MOCK_PRESS(0,1,5)
        ZMK_MOCK_RELEASE(0,1,5)
        ZMK_MOCK_RELEASE(1,0,5)
        ZMK_MOCK_RELEASE(0,0,35)
        ZMK_MOCK_PRESS(0,3,20)
        ZMK_MOCK_RELEASE(0,3,10)
    >;
};
