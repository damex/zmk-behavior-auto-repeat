// Copyright 2026 Roman Kuzmitskii (@damex)
// SPDX-License-Identifier: MIT

#include "../../keymap.dtsi"

&auto_repeat {
    max-active = <2>;
};

&kscan {
    /delete-property/ exit-after;
    events = <
        ZMK_MOCK_PRESS(0,0,5)
        ZMK_MOCK_PRESS(0,1,5)
        ZMK_MOCK_RELEASE(0,1,5)
        ZMK_MOCK_PRESS(0,2,5)
        ZMK_MOCK_RELEASE(0,2,5)
        ZMK_MOCK_PRESS(0,3,5)
        ZMK_MOCK_RELEASE(0,3,5)
        ZMK_MOCK_RELEASE(0,0,10)
    >;
};
